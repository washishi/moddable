## build/devices/esp32/targets/m5stack_cores3/sdkconfig/sdkconfig.defaults
```kconfig
CONFIG_TINYUSB=y
CONFIG_TINYUSB_CDC_ENABLED=y

#
# Descriptor configuration
#
CONFIG_TINYUSB_DESC_USE_ESPRESSIF_VID=n
CONFIG_TINYUSB_DESC_USE_DEFAULT_PID=n
CONFIG_TINYUSB_DESC_CUSTOM_VID=0xbeef
CONFIG_TINYUSB_DESC_CUSTOM_PID=0x1cee
CONFIG_TINYUSB_DESC_BCD_DEVICE=0x0100
CONFIG_TINYUSB_DESC_MANUFACTURER_STRING="Moddable"
CONFIG_TINYUSB_DESC_PRODUCT_STRING="Moddable"
CONFIG_TINYUSB_DESC_SERIAL_STRING="123456"
CONFIG_TINYUSB_DESC_CDC_STRING="xsbug"
# end of Descriptor configuration

#CONFIG_CONSOLE_UART_DEFAULT=y
CONFIG_CONSOLE_UART=y
CONFIG_CONSOLE_UART_NUM=0
CONFIG_CONSOLE_UART_BAUDRATE=115200

CONFIG_ESPTOOLPY_FLASHFREQ_80M=y
CONFIG_ESPTOOLPY_FLASHSIZE_16MB=y
CONFIG_ESPTOOLPY_FLASHSIZE="16MB"

CONFIG_ESP_SYSTEM_PANIC_GDBSTUB=n
CONFIG_ESP_COREDUMP_ENABLE_TO_UART=n
CONFIG_ESP_COREDUMP_ENABLE=n

#CONFIG_FLASHMODE_QIO=y
CONFIG_FLASHMODE_DIO=y

#
# SPI RAM config
#
CONFIG_SPIRAM_TYPE_AUTO=y
CONFIG_SPIRAM_SIZE=-1
CONFIG_SPIRAM_SPEED_80M=y
CONFIG_SPIRAM=y
CONFIG_SPIRAM_BOOT_INIT=y
CONFIG_SPIRAM_USE_MALLOC=y

CONFIG_SPIRAM_BANKSWITCH_ENABLE=y
CONFIG_SPIRAM_BANKSWITCH_RESERVE=8
```
